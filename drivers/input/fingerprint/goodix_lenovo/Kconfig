## drivers/input/fingerprint/goodix_lenovo/Kconfig
```kconfig
config FINGERPRINT_GOODIX_LENOVO
	tristate "Goodix TEE fingerprint sensor (Lenovo TB371FC)"
	depends on INPUT_FINGERPRINT && !FINGERPRINT_GOODIX && !FINGERPRINT_GOODIX_FOD
	help
	  Platform driver for the Goodix side-key fingerprint sensor used on
	  the Lenovo TB371FC. The sensor itself is driven over SPI from the
	  TEE; this driver owns its supply, reset and interrupt lines and
	  exposes /dev/goodix_fp plus the netlink event channel used by the
	  Goodix fingerprint HAL.

	  If unsure, say N.
```

## drivers/misc/ctn730/Kconfig
```kconfig
config NFC_NXP_CTN730
	tristate "NXP CTN730 stylus wireless charger"
	depends on I2C && OF
	help
	  Driver for the NXP CTN730 NFC wireless charger that charges the
	  stylus of the Lenovo TB371FC and reports its attachment, charge
	  state and battery level.
```

## techpack/Kconfig
```kconfig
menu "Tech packages"

source "techpack/data/Kconfig"

menu "Camera packages"

config TECHPACK_CAMERA_XIAOMI
    bool "Xiaomi camera"
    help
      Xiaomi camera

config TECHPACK_CAMERA_XIAOMI_CAS
    bool "Xiaomi camera CAS"
    help
      Xiaomi camera CAS

config TECHPACK_CAMERA_XIAOMI_TABLET
    bool "Xiaomi camera tablet"
    help
      Xiaomi camera tablet

config TECHPACK_CAMERA_NONE
    bool "No camera techpack"
    help
      Don't build any camera techpack (bring-up / size testing).

endmenu

endmenu
```

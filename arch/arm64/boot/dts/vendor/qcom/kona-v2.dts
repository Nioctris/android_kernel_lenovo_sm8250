/dts-v1/;

#include "kona-v2.dtsi"
#include "kona-tb9707f-display.dtsi"
#include "kona-tb9707f-touch.dtsi"

/ {
	model = "Qualcomm Technologies, Inc. kona v2 SoC";
	compatible = "qcom,kona";
	qcom,board-id = <0 0>;
};

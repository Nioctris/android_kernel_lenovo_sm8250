/dts-v1/;

#include "kona.dtsi"
#include "kona-tb9707f-display.dtsi"
#include "kona-tb9707f-touch.dtsi"
#include "kona-tb9707f-wlan.dtsi"
#include "kona-tb9707f-memory.dtsi"

/ {
	model = "Qualcomm Technologies, Inc. kona v1 SoC";
	compatible = "qcom,kona";
	qcom,board-id = <0 0>;
};

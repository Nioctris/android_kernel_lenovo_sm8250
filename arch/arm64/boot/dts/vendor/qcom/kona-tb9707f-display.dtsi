// SPDX-License-Identifier: GPL-2.0-only

&qupv3_se5_i2c {
	/* The Lenovo overlay supplies the enable GPIO for this node. */
	tb9707f_backlight: KTZ8866@11 {
		compatible = "ktz,ktz8866";
		reg = <0x11>;
	};
};

&{/soc} {
	/* The stock overlay populates the primary display node. */
	qcom,dsi-display-primary {
		backlight = <&tb9707f_backlight>;
	};
};
